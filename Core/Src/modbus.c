#include "modbus.h"
// #include "timer.h"
#include "usart.h"
#include "tim.h"
uint8_t	modbus_Tx_buff[100];				//发送缓冲区
int16_t modbus_virtual_register[2]={1,0}; 	//虚拟寄存器初始值 {busy,angle}
int16_t PwmNum=0;
/* 发送数据函数，buff为发送内容，len表示发送字节数 */
void modbus_send_data(uint8_t *buff,uint8_t len)
{
	  HAL_UART_Transmit_IT(&huart1,(uint8_t*)buff,len);      //发送数据
	  while(__HAL_UART_GET_FLAG(&huart1,UART_FLAG_TC)!=SET);		//等待发送结束
}

/* modbus服务函数 */
void modbus_service(void)
{
	uint16_t data_CRC_value;   		//从机收到的CRC校验码
	uint16_t data_len;         		//从机收到的modbus数据长度S
	uint16_t CRC_check_result; 		//从机根据收到的数据计算出来的CRC校验码
	if(USART_RX_STA&0x8000)     //串口接收完成的标志
	{
		data_len = USART_RX_STA & 0x3fff ;
		CRC_check_result = CRC16(USART_RX_BUF,data_len-2);
		data_CRC_value= USART_RX_BUF[data_len-1]<<8 | (((uint16_t)USART_RX_BUF[data_len-2])); //对于CRC的接收，先接收低位，再接收高位（组合校验码）
		if(CRC_check_result==data_CRC_value)  //校验通过
		{
			if(USART_RX_BUF[0]==code_key)  //判断从机地址
			{
				switch(USART_RX_BUF[1])   //选择功能码
				{
					case 04:     //读多个寄存器
					{
						modbus_04_function();
						break;
					}
					case 06:      //写单个寄存器
					{
						modbus_06_function();
						break;
					}
					case 16:      //写多个寄存器
					{
						modbus_16_function();
						break;
					}

				}
			}
		}
		USART_RX_STA=0;  //开始下一次接收
	}
}

/*
​ 地址 （bit） 功能码(8bit)       数据                         校验（16bit）

  主机： 01   03          00 00  00 05                     C5  CD

  从机： 01   03        0A 00 00 00 01 00 02 00 03 00 04   C5  CD
*/

void modbus_04_function(void)
{

	uint16_t i;
	uint16_t arr_start=3;   //从机回复寄存器的值是从数组的第3位开始
	uint16_t register_len;  //查询寄存器的数量
	uint16_t register_start;		 //查询寄存器的起始地址
	modbus_Tx_buff[0] = code_key;  //从机地址
	modbus_Tx_buff[1] = 04;  //功能码
	register_len = USART_RX_BUF[5]|(((uint16_t)USART_RX_BUF[4])<<8);  //查询寄存器的数量(16bit)
	modbus_Tx_buff[2] = register_len * 2;  //要发送的数据长度（8bit）
	register_start = USART_RX_BUF[3]|(((uint16_t)USART_RX_BUF[2])<<8);  //查询寄存器的起始地址（16bit）
	for(i=0 ; register_len >i ; i++,register_start++)   
	{
		modbus_Tx_buff[arr_start]=modbus_virtual_register[register_start]>>8&0xFF;// 低字节
		arr_start++;
		modbus_Tx_buff[arr_start]=modbus_virtual_register[register_start]&0xFF; // 高字节
		arr_start++;
	}
	//由于++ 所以arr_start此时走到校验位
	arr_start=CRC16(modbus_Tx_buff,register_start*2+3); //CRC校验
	modbus_Tx_buff[register_start*2+3]=(arr_start)&0xFF;
	modbus_Tx_buff[register_start*2+4]=(arr_start>>8)&0xFF;
	modbus_send_data(modbus_Tx_buff,register_start*2+5);
}
/*
主机发送： 01 06 00 00 00 06 09 C8
地址 功能码 数据内容（地址，内容） 校验
主机接收： 01 06 00 00 00 06 09 C8
*/

// 写单个寄存器
void modbus_06_function(void)
{
	uint16_t register_addr;				//主机想要修改从机的指定寄存器编号
	if(modbus_virtual_register[0] == 0){  //电机正在转动接受的值旋转
		return;
	}

	register_addr = USART_RX_BUF[3]|(((uint16_t)USART_RX_BUF[2])<<8);  //要 写入的寄存器地址
	uint16_t temp = USART_RX_BUF[5]|(((uint16_t)USART_RX_BUF[4])<<8);
	if(Compare_Register(&modbus_virtual_register[register_addr],temp)==0){
		return;
	}

	modbus_virtual_register[0] = 0;  //busy   1.空闲  0.忙碌
	modbus_Tx_buff[0]=USART_RX_BUF[0];
	modbus_Tx_buff[1]=USART_RX_BUF[1];
	modbus_Tx_buff[2]=USART_RX_BUF[2];
	modbus_Tx_buff[3]=USART_RX_BUF[3];
	modbus_Tx_buff[4]=USART_RX_BUF[4];
	modbus_Tx_buff[5]=USART_RX_BUF[5];



	register_addr=CRC16(modbus_Tx_buff,6); //CRC校验
	modbus_Tx_buff[6]=(register_addr)&0xFF;
	modbus_Tx_buff[7]=(register_addr>>8)&0xFF;

	modbus_send_data(modbus_Tx_buff,8);  //返回给主机

}

// 写多个寄存器
void modbus_16_function(void)
{

	uint16_t i;
	uint16_t register_start;	   //修改寄存器的起始地址
	uint16_t register_num;		   //修改寄存器的数量
	uint16_t CRC_check_result;  //CRC校验的结果
	modbus_Tx_buff[0]=USART_RX_BUF[0];
	modbus_Tx_buff[1]=USART_RX_BUF[1];
	modbus_Tx_buff[2]=USART_RX_BUF[2];
	modbus_Tx_buff[3]=USART_RX_BUF[3];
	modbus_Tx_buff[4]=USART_RX_BUF[4];
	modbus_Tx_buff[5]=USART_RX_BUF[5];
	CRC_check_result=CRC16(modbus_Tx_buff,6);
	modbus_Tx_buff[6]=(CRC_check_result)&0xFF;
	modbus_Tx_buff[7]=(CRC_check_result>>8)&0xFF;

	register_start = USART_RX_BUF[3]|(((uint16_t)USART_RX_BUF[2])<<8);
	register_num = USART_RX_BUF[5]|(((uint16_t)USART_RX_BUF[4])<<8);
	for( i =0;i<register_num;i++)
	{
		modbus_virtual_register[register_start+i] = USART_RX_BUF[8+i*2]|(((uint16_t)USART_RX_BUF[7+i*2])<<8);
	}
	modbus_send_data(modbus_Tx_buff,8);

}

unsigned int CRC16(unsigned char *puchMsg,  unsigned char usDataLen)/* 函数以 unsigned short 类型返回 CRC */
/* puchMsg 用于计算 CRC 的报文 */
/* usDataLen 报文中的字节数 */
{

	unsigned char uchCRCHi = 0xFF ; /* CRC 的高字节初始化 */
	unsigned char uchCRCLo = 0xFF ; /* CRC 的低字节初始化 */
	unsigned short int uIndex ; /* CRC 查询表索引 */
	unsigned char auchCRCHi[] = {
		0x00, 0xC1, 0x81, 0x40, 0x01, 0xC0, 0x80, 0x41, 0x01, 0xC0, 0x80, 0x41,
		0x00, 0xC1, 0x81,
		0x40, 0x01, 0xC0, 0x80, 0x41, 0x00, 0xC1, 0x81, 0x40, 0x00, 0xC1, 0x81,
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		0x00, 0xC1, 0x81,
		0x40
    } ;
	unsigned char auchCRCLo[] = {
		0x00, 0xC0, 0xC1, 0x01, 0xC3, 0x03, 0x02, 0xC2, 0xC6, 0x06, 0x07, 0xC7,
		0x05, 0xC5, 0xC4,
		0x04, 0xCC, 0x0C, 0x0D, 0xCD, 0x0F, 0xCF, 0xCE, 0x0E, 0x0A, 0xCA, 0xCB,
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		0x41, 0x81, 0x80,
		0x40
    } ;

   while (usDataLen--) /* 完成整个报文缓冲区 */
	{
		uIndex = uchCRCLo ^ *puchMsg++ ; /* 计算 CRC */
		uchCRCLo = uchCRCHi ^ auchCRCHi[uIndex] ;
		uchCRCHi = auchCRCLo[uIndex] ;
	}
	return (uchCRCHi << 8 | uchCRCLo) ;
}


//判定当前寄存器值与接收值，选择方向
uint8_t Compare_Register(int16_t *register_value,int16_t angle){
	if(*register_value == angle){
		return 0;
	}
	if(*register_value < angle){ 			  //正转
		HAL_GPIO_WritePin(GPIOC, DIR_Pin, 1);
		PwmNum = ANGLE_BASE*(angle-*register_value);   //确定旋转的角度
	}else{
		HAL_GPIO_WritePin(GPIOC, DIR_Pin, 0);
		PwmNum = ANGLE_BASE*(*register_value-angle);
	}
	HAL_GPIO_WritePin(GPIOC, ENAB_Pin, 0);    //使能
	*register_value = angle;
	HAL_TIM_PWM_Start_IT(&htim3,TIM_CHANNEL_3);//产生pwm输出
	return 1;
}
